## drivers/nfc/sn1x0_spi/Kconfig
```kconfig
#
# Nxp Nci protocol (I2C) devices
#

config NXP_P73_DEVICES
	bool "Nxp p73"
	default n
	---help---
	  You'll have to say Y if your computer contains an SPI device that
	  you want to use under Linux.

	  You can say N here if you don't have any SPI connected to your computer.
```
